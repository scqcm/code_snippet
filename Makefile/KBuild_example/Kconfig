## Makefile/KBuild_example/Kconfig
```kconfig
mainmenu "Kbuild Test Configuration"

menu TEST_KBUILD

config ARM
	tristate "enable gcc arm"
config x86
	bool "enable gcc x86"
config MYPRINT
	bool "enable myprint.c"
	help
	this is a test

endmenu
```
